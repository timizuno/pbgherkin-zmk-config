## config/boards/shields/pbgherkin/Kconfig.defconfig
```kconfig
# Copyright (c) 2021 purple-rw
# SPDX-License-Identifier: MIT

if SHIELD_PBGHERKIN

config ZMK_KEYBOARD_NAME
    default "PB Gherkin"

endif
```
